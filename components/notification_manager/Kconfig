## components/notification_manager/Kconfig
```kconfig
menu "Status LED"

    config STATUS_LED_GPIO
        int "Addressable (WS2812) LED GPIO"
        default 38
        help
            ESP32-S3-DevKitC-1 v1.1 has its RGB LED on GPIO38; v1.0 has it on GPIO48.

    config STATUS_LED_BRIGHTNESS_PERCENT
        int "Brightness cap (percent)"
        range 1 100
        default 20
        help
            A WS2812 at full power is blinding. Every color, including the ones set
            from the web UI, is scaled by this percentage.

endmenu
```

## components/rest_server/Kconfig.projbuild
```kconfig
menu "Netlab web access"

    config NETLAB_AUTH_ENABLE
        bool "Require a login for the web UI and the API"
        default y
        help
            The web page asks for a user name and password and every API route needs the
            session token it gets back ("Authorization: Bearer <token>"). The login page, the
            static files, GET /api/v1/about and, while the Wi-Fi setup network is open, the three
            Wi-Fi provisioning routes stay public: a phone joining the setup network has to be able
            to reach them. In router lab mode, POST /api/v1/router/lab (the lab service students'
            devices call) is public too; it records only while the capture is on.

            Turn it off to go back to an open API (anyone on the network can use it).

    config NETLAB_ADMIN_USER
        string "Administrator user name"
        default "admin"
        depends on NETLAB_AUTH_ENABLE

    config NETLAB_ADMIN_PASSWORD
        string "Administrator password (LAB ONLY, plain text)"
        default "admin"
        depends on NETLAB_AUTH_ENABLE
        help
            LAB ONLY. This value is compiled into the firmware and written in clear text to
            sdkconfig, and this repository is public, so the default is known to everyone. The web
            UI is plain HTTP, so the browser also sends it in clear over the network at each login.
            That is acceptable on a home network you control; do not expose the device to the
            internet. Set your own value in menuconfig: it lands in sdkconfig, which git ignores.

    config NETLAB_SESSION_TTL_MIN
        int "Session lifetime without use (minutes)"
        default 30
        range 1 1440
        depends on NETLAB_AUTH_ENABLE
        help
            Each request extends the session, so it only ends after this long without any.
            Up to four sessions live at once (a phone and a PC); a fifth login replaces the one
            that would expire first.

endmenu
```

## components/wifi_bridge/Kconfig
```kconfig
menu "Wi-Fi bridge"

    config WIFI_BRIDGE_SETUP_AP_SSID
        string "Setup network name"
        default "Netlab-Fraga"
        help
            Name of the Wi-Fi network the device opens when it needs to be configured
            (1 to 32 characters). Two devices with the same name in range are hard to
            tell apart: change it on the second one.

    config WIFI_BRIDGE_SETUP_AP_PASSWORD
        string "Setup network password"
        default "netlabsetup"
        help
            WPA2 password of the setup network (8 to 63 characters), or empty for an open
            network. It protects the moment you type your router's password, so change it
            if you do not want neighbors who read this repository to be able to join.

    config WIFI_BRIDGE_SETUP_AP_MAX_CLIENTS
        int "Maximum devices on the setup network"
        range 1 4
        default 2

    config WIFI_BRIDGE_FALLBACK_SECONDS
        int "Open the setup network after this many seconds without a connection"
        range 20 3600
        default 90
        help
            When a saved network cannot be reached (the device moved to another house, or
            the router is down), the setup network opens after this delay so a new router
            can be chosen. It closes again on its own once the device is back online.
            If the saved network is not found at all (not in range), it is forgotten and the
            device restarts straight into setup mode instead.

    menuconfig WIFI_BRIDGE_ROUTER_MODE
        bool "Router lab mode (for an authorized classroom lab)"
        default n
        select LWIP_IP_FORWARD
        select LWIP_IPV4_NAPT
        help
            Once the device is online it opens a second, separate Wi-Fi network (the "lab
            network"), hands out addresses by DHCP and routes its clients to the saved network
            through IPv4 NAT. The dashboard shows the lab clients and, only while capture is on,
            which addresses and DNS names they reach. Payloads are never stored.
            Only use it on networks and with devices you are allowed to observe.

    if WIFI_BRIDGE_ROUTER_MODE

    config WIFI_BRIDGE_ROUTER_SSID
        string "Lab network name"
        default "Netlab-Lab"
        help
            1 to 32 characters. Must not be the name of the saved network or of any other real
            network: the lab network never pretends to be another one, and it refuses to open
            under the saved network's name.

    config WIFI_BRIDGE_ROUTER_PASSWORD
        string "Lab network password"
        default "netlablab"
        help
            WPA2 password, 8 to 63 characters. The lab network is never open.

    config WIFI_BRIDGE_ROUTER_IP
        string "Lab network address"
        default "192.168.4.1"
        help
            Address of the device on the lab network (and the setup network), a /24. Clients get
            addresses from the same /24 by DHCP. Change it when the saved network already uses
            this /24, for example 192.168.42.1: the lab network does not open while the two clash.

    config WIFI_BRIDGE_ROUTER_MAX_CLIENTS
        int "Maximum devices on the lab network"
        range 1 8
        default 4
        help
            Every client shares the radio with the uplink: a few devices keep it usable.

    config WIFI_BRIDGE_ROUTER_CAPTURE_DEFAULT
        bool "Capture on at boot"
        default n
        help
            Capture records flows and DNS names of lab clients. Off by default: turn it on from
            the dashboard when the class has agreed to it.

    config WIFI_BRIDGE_ROUTER_FLOWS_MAX
        int "Flows kept"
        range 8 256
        default 64
        help
            Client, destination address, port and protocol, with packet and byte counts. When
            full, the flow seen least recently is dropped. Kept in RAM only.

    config WIFI_BRIDGE_ROUTER_DNS_MAX
        int "DNS names kept"
        range 4 64
        default 16
        help
            The most recent DNS names asked by lab clients (a ring). Kept in RAM only.

    endif

endmenu
```

## main/Kconfig.projbuild
```kconfig
menu "Netlab"

    config NETLAB_MDNS_HOSTNAME
        string "mDNS host name"
        default "netlab"
        help
            The web UI is reachable at http://<name>.local

    config NETLAB_DEPLOY_WEB_PAGES
        bool "Flash the web UI (front/web/dist) into the www partition"
        default y
        help
            Needs 'pnpm install && pnpm build' in front/web first. Disable it while
            developing the UI with 'pnpm dev': the Vite dev server proxies /api to
            the device, so nothing has to be flashed for UI changes.

    config NETLAB_RESET_BUTTON_GPIO
        int "Reset button GPIO"
        range 0 48
        default 0
        help
            Holding this button forgets the saved Wi-Fi network and restarts into setup
            mode. GPIO0 is the BOOT button on ESP32-S3-DevKitC-1. Hold it after the
            board has booted (holding it while powering on enters the flash bootloader).

    config NETLAB_RESET_HOLD_MS
        int "Hold time to reset the Wi-Fi network (ms)"
        range 1000 30000
        default 5000

endmenu
```
